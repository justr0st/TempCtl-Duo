// HTTP server: single-page web UI + JSON API.
// No authentication: keep the device on a trusted network.
#include "web.h"
#include "psram.h"
#include "console.h"
#include "ui.h"
#include "syslog.h"
#include "sdlog.h"
#include "backup.h"
#include "crumbs.h"
#include <LittleFS.h>
#include <ArduinoJson.h>
#include <WebServer.h>
#include <WiFi.h>
#include <errno.h>
#include <esp_heap_caps.h>
#include <lwip/sockets.h>
#include <math.h>
#include <memory>
#include <new>
#include "app_state.h"
#include "safety.h"
#include "ota.h"
#include <esp_task_wdt.h>
#include "controller.h"
#include "local_ctrl.h"
#include "net.h"
#include "settings_store.h"
#include "host_check.h"
#ifdef BOARD_DEMO
#include "demo_assets.h"  // the browser demo: the page is not served by the firmware (demo/)
#else
#include "web_assets.h"  // new page + fonts (generated by tools/web_embed.py from web/)
#endif

static WebServer server(80);

// ------------------------------------------------------------ request checks (HTTP; the serial api is local)
// Every POST must carry the header "X-TempCtl: 1". A browser sends a custom header cross-site only after a CORS
// preflight (OPTIONS), which the device never allows, so a script on some other web page open in the workshop
// cannot switch the heaters, change settings or upload firmware (simple text/plain or form POSTs need no
// preflight and were accepted before). The web page sets it in api() and the firmware upload; scripts (curl,
// PowerShell) must send it too.
static const char* const POST_HEADER = "X-TempCtl";
static bool postHeaderOk() { return server.hasHeader(POST_HEADER) && server.header(POST_HEADER).length() > 0; }

// The API answers only requests addressed to this device: Host = an IP address, the host name, or the host name
// with a local network suffix (.local, a router's .lan / .fritz.box ...). Against DNS rebinding: a web page whose
// own name was pointed at the device's address afterwards would be same-origin for the browser, but its
// requests still carry that page's name. Refused hosts are logged (once each in a row) - if a legitimate way of
// opening the device is refused, its name belongs on the list.
static bool hostOk() {
  const String h = server.hostHeader();
  char name[24];
  {
    Guard g;
    strlcpy(name, gSettings.hostname[0] ? gSettings.hostname : DEFAULT_HOSTNAME, sizeof(name));
  }
  // the host name of the settings and the one in use since the start (a new name is used after a restart)
  const char* names[2] = {name, WiFi.getHostname()};
  if (hostAllowed(h.c_str(), names, 2)) return true;
  static String lastRefused;
  if (lastRefused != h) {
    lastRefused = h;
    LogSerial.printf("[web] request refused: Host \"%s\" is not this device (IP address, %s, %s.local)\n", h.c_str(),
                     name, name);
  }
  return false;
}


// ------------------------------------------------------------ request source: HTTP or the serial api mode
// The handlers read their parameters with reqHas() / reqArg() / parseBody() and answer with sendBody()
// / sendStream(): from and to the HTTP client, or (while webApiRequest() runs a request from the
// serial api mode, spec 7b) from the request line and as JSON lines (console.cpp queues them).
struct SerialReq {
  uint32_t id;
  const char* path;
  const char* query;  // "a=1&b=2" (or "")
  String body;        // the request's "b" as JSON text
  bool answered;
};
static SerialReq* sreq = nullptr;

static int hexVal(char c) { return c >= '0' && c <= '9' ? c - '0' : (c | 32) >= 'a' && (c | 32) <= 'f' ? (c | 32) - 'a' + 10 : -1; }

// query parameter of the serial request (URL-decoded)
static bool queryArg(const char* key, String* out) {
  const size_t kl = strlen(key);
  for (const char* p = sreq->query; *p;) {
    const char* e = strchr(p, '&');
    const size_t n = e ? (size_t)(e - p) : strlen(p);
    if (n > kl && !strncmp(p, key, kl) && p[kl] == '=') {
      if (out) {
        *out = "";
        for (size_t i = kl + 1; i < n; ++i) {
          if (p[i] == '+') *out += ' ';
          else if (p[i] == '%' && i + 2 < n + 1 && hexVal(p[i + 1]) >= 0 && hexVal(p[i + 2]) >= 0) {
            *out += (char)(hexVal(p[i + 1]) * 16 + hexVal(p[i + 2]));
            i += 2;
          } else *out += p[i];
        }
      }
      return true;
    }
    if (n == kl && !strncmp(p, key, kl)) {  // "key" without a value
      if (out) *out = "";
      return true;
    }
    p += n + (e ? 1 : 0);
  }
  return false;
}
static bool reqHas(const char* k) { return sreq ? queryArg(k, nullptr) : server.hasArg(k); }
static String reqArg(const char* k) {
  if (!sreq) return server.arg(k);
  String v;
  queryArg(k, &v);
  return v;
}
static String reqUri() { return sreq ? String(sreq->path) : server.uri(); }

// JSON string content (no quotes), appended
static void jsonEscape(String& o, const char* s, size_t n) {
  for (size_t i = 0; i < n; ++i) {
    const uint8_t c = (uint8_t)s[i];
    if (c == '"' || c == '\\') {
      o += '\\';
      o += (char)c;
    } else if (c == '\n') {
      o += "\\n";
    } else if (c == '\r') {
      o += "\\r";
    } else if (c == '\t') {
      o += "\\t";
    } else if (c < 0x20) {
      char u[8];
      snprintf(u, sizeof(u), "\\u%04x", c);
      o += u;
    } else {
      o += (char)c;
    }
  }
}

// serial answer: JSON as {"id":..,"code":..,"body":...}; other types as chunks + {"id":..,"end":true}
static void serialChunk(int code, const char* type, const char* data, size_t n) {
  String line;
  line.reserve(n + n / 8 + 96);
  line = "{\"id\":";
  line += sreq->id;
  line += ",\"code\":";
  line += code;
  line += ",\"type\":\"";
  line += type;
  line += "\",\"chunk\":\"";
  jsonEscape(line, data, n);
  line += "\"}\n";
  apiOut(line.c_str(), line.length());
  apiFlush(8192);  // long text: sent piece by piece
}
static void serialEnd() {
  char b[48];
  const int k = snprintf(b, sizeof(b), "{\"id\":%lu,\"end\":true}\n", (unsigned long)sreq->id);
  apiOut(b, k);
}
static void serialAnswer(int code, const char* type, const uint8_t* data, size_t len) {
  sreq->answered = true;
  if (!strncmp(type, "application/json", 16)) {
    char h[64];
    const int k = snprintf(h, sizeof(h), "{\"id\":%lu,\"code\":%d,\"body\":", (unsigned long)sreq->id, code);
    apiOut(h, k);
    if (len) apiOut((const char*)data, len);
    else apiOut("null", 4);
    apiOut("}\n", 2);
    return;
  }
  for (size_t off = 0; off < len; off += 1024) serialChunk(code, type, (const char*)data + off, len - off < 1024 ? len - off : 1024);
  serialEnd();
}

// ------------------------------------------------------------ helpers
// Every response (status line, headers and body) is written straight on the socket, non-blocking,
// in TCP-sized pieces. WiFiClient::write retries a stuck connection for 10 s per call and blocks the
// loop (touch UI, watchdog); here a connection without progress for 5 s is dropped and logged.
static String extraHeaders;  // set before sendBody(): "Name: value\r\n" lines

static bool sendRaw(int fd, const uint8_t* data, size_t len, size_t& sent, uint32_t& last) {
  size_t done = 0;
  while (done < len) {
    const size_t n = len - done < 1436 ? len - done : 1436;
    const int w = send(fd, data + done, n, MSG_DONTWAIT);
    if (w > 0) {
      done += (size_t)w;
      sent += (size_t)w;
      last = millis();
      feedLoopWDT();
      continue;
    }
    if (w < 0 && errno != EAGAIN && errno != EWOULDBLOCK) return false;  // closed / reset by the browser
    if (millis() - last > 5000) return false;
    delay(2);
  }
  return true;
}

static void sendBody(int code, const char* type, const uint8_t* data, size_t len, const char* what) {
  if (sreq) {
    extraHeaders = "";
    return serialAnswer(code, type, data, len);
  }
  WiFiClient c = server.client();
  const int fd = c.fd();
  String head;
  head.reserve(160 + extraHeaders.length());
  head = "HTTP/1.1 ";
  head += code;
  head += code == 200 ? " OK" : code == 404 ? " Not Found" : code == 403 ? " Forbidden" : code == 500 ? " Internal Server Error" : code == 503 ? " Service Unavailable" : " Bad Request";
  head += "\r\nContent-Type: ";
  head += type;
  head += "\r\nContent-Length: ";
  head += (unsigned)len;
  head += "\r\nConnection: close\r\n";
  head += extraHeaders;
  head += "\r\n";
  extraHeaders = "";
  size_t sent = 0;
  uint32_t last = millis();
  const bool ok = fd >= 0 && sendRaw(fd, (const uint8_t*)head.c_str(), head.length(), sent, last) &&
                  sendRaw(fd, data, len, sent, last);
  if (!ok && fd >= 0 && millis() - last > 5000)
    LogSerial.printf("[web] %s: no progress for 5 s after %u of %u bytes - dropped (DRAM %u free, %u min, "
                  "%u largest)\n",
                  what, (unsigned)sent, (unsigned)(head.length() + len),
                  (unsigned)heap_caps_get_free_size(MALLOC_CAP_8BIT | MALLOC_CAP_INTERNAL),
                  (unsigned)heap_caps_get_minimum_free_size(MALLOC_CAP_8BIT | MALLOC_CAP_INTERNAL),
                  (unsigned)heap_caps_get_largest_free_block(MALLOC_CAP_8BIT | MALLOC_CAP_INTERNAL));
  if (!ok) c.stop();
}

// A body of unknown length (ended by closing the connection), produced piece by piece by `next`
// (returns 0 when done) into a buffer on the stack
template <typename F>
static void sendStream(const char* type, const char* what, F next) {
  if (sreq) {
    extraHeaders = "";
    sreq->answered = true;
    char buf[1024];
    for (size_t n; (n = next(buf, sizeof(buf))) > 0;) serialChunk(200, type, buf, n);
    return serialEnd();
  }
  WiFiClient c = server.client();
  const int fd = c.fd();
  String head = "HTTP/1.1 200 OK\r\nContent-Type: ";
  head += type;
  head += "\r\nConnection: close\r\n";
  head += extraHeaders;
  head += "\r\n";
  extraHeaders = "";
  size_t sent = 0;
  uint32_t last = millis();
  bool ok = fd >= 0 && sendRaw(fd, (const uint8_t*)head.c_str(), head.length(), sent, last);
  head = String();
  char buf[1436];
  while (ok) {
    const size_t n = next(buf, sizeof(buf));
    if (!n) break;
    ok = sendRaw(fd, (const uint8_t*)buf, n, sent, last);
  }
  if (!ok && fd >= 0) LogSerial.printf("[web] %s: dropped after %u bytes\n", what, (unsigned)sent);
  c.stop();
}

static void sendText(int code, const char* type, const String& body) {
  sendBody(code, type, (const uint8_t*)body.c_str(), body.length(), reqUri().c_str());
}

static void sendJson(JsonDocument& d, int code = 200) {
  String out;
  serializeJson(d, out);
  sendText(code, "application/json", out);
}

static void sendError(const char* msg, int code = 400) {
  JsonDocument d;
  d["ok"] = false;
  d["err"] = msg;
  sendJson(d, code);
}

static bool parseBody(JsonDocument& d) {
  if (sreq) return sreq->body.length() && deserializeJson(d, sreq->body) == DeserializationError::Ok;
  if (!server.hasArg("plain")) return false;
  return deserializeJson(d, server.arg("plain")) == DeserializationError::Ok;
}

// works on a document member (doc["x"]) too: a MemberProxy converted to a
// JsonVariant does not create the member, so assign through the proxy itself
// (by reference: ArduinoJson 7.4 proxies cannot be copied)
template <typename T>
static void setNum(T&& v, float x) {
  if (isnan(x)) v.set(nullptr);
  else v.set(roundf(x * 10.0f) / 10.0f);
}

// ------------------------------------------------------------ status / history
// "autotune" of a local channel (nothing while no autotune ran)
static void tuneJson(JsonObject o, int ch) {
  LocalTune t;
  localCtrlTuneGet(ch, t);
  if (t.state == TuneState::Idle) return;
  static const char* const TS[] = {"idle", "running", "done", "failed"};
  JsonObject a = o["autotune"].to<JsonObject>();
  a["state"] = TS[(int)t.state];
  setNum(a["sp"], t.sp);
  a["cycle"] = t.cycle;
  a["elapsed"] = (int)t.elapsed;
  a["msg"] = JsonString(t.msg);
  if (t.state == TuneState::Done) {
    a["kp"] = t.res.kp;
    a["ki"] = t.res.ki;
    a["kd"] = t.res.kd;
    a["ku"] = t.res.ku;
    a["pu"] = t.res.pu;
  }
}

static void stageJson(JsonObject o, const StageInfo& si) {
  o["idx"] = si.idx;
  o["stage"] = stageName(si.st);
  o["el"] = roundf(si.el * 10) / 10;
  o["dur"] = roundf(si.dur * 10) / 10;
}

// "run" object of /api/status: the fields of the old page (bottom channel / Sequence phase; for a
// Timeline the bottom's lane, the top's when the bottom has no steps) plus the Duo run state for both channels
static void runStatusJson(JsonObject r, const LiveData& L) {
  const bool tl = L.progType == PROG_TL;
  const int lc = (tl && L.steps[ENGINE_CH] == 0) ? CH_TOP : ENGINE_CH;
  const StageInfo& si = tl ? L.lane[lc] : L.seq;
  r["state"] = runStateName(L.state);
  r["phase"] = stageName(si.st);  // legacy: ramp / hold / wait / ...
  r["step"] = si.idx;
  r["phaseEl"] = si.el;
  r["phaseDur"] = si.dur > si.el ? si.dur : si.el;  // wait / pause: nothing "left"
  r["elapsed"] = L.elapsed;
  r["total"] = L.elapsed + L.remaining;
  r["remaining"] = L.remaining;
  r["soakWait"] = L.waiting;
  setNum(r["hostSp"], L.run[ENGINE_CH].sp);
  setNum(r["target"], L.run[ENGINE_CH].target);  // NaN while the bottom is idle
  r["spSynced"] = L.spSyncedCh[ENGINE_CH];
  r["spWrites"] = L.spWritesCh[ENGINE_CH];
  r["msg"] = JsonString(L.runMsg);
  r["prog"] = L.runProg;
  r["name"] = JsonString(L.runName);
  r["steps"] = tl ? L.steps[lc] : L.phases;
  if (L.runProg < 0) return;
  r["type"] = progTypeName(L.progType);
  r["waiting"] = L.waiting;
  r["progPause"] = L.progPause;
  r["actionRequired"] = L.pauseMsg;
  r["pauseText"] = JsonString(L.pauseText);
  r["edited"] = L.runEdited;
  if (L.progType == PROG_SEQ) {
    stageJson(r["seq"].to<JsonObject>(), L.seq);
    r["phases"] = L.phases;
  }
  JsonArray a = r["channels"].to<JsonArray>();
  for (int i = 0; i < NUM_CHANNELS; ++i) {
    const ChOut& o = L.run[i];
    JsonObject c = a.add<JsonObject>();
    c["inProgram"] = o.inProgram;
    c["idle"] = o.idle;
    setNum(c["sp"], o.sp);
    setNum(c["target"], o.target);
    c["moving"] = o.moving;
    c["synced"] = L.spSyncedCh[i];
    c["spWrites"] = L.spWritesCh[i];
    if (L.progType == PROG_TL) {
      stageJson(c["lane"].to<JsonObject>(), L.lane[i]);
      c["steps"] = L.steps[i];
    }
  }
}

// The old page's status (TempCtl 1.2): the flat fields are the bottom channel
static void handleStatus() {
  std::unique_ptr<LiveData> lp(new (std::nothrow) LiveData());
  ScratchSettings sp;
  if (!lp || !sp) return sendError("Out of memory - try again", 503);
  const LiveData& L = *lp;
  const Settings& S = *sp;
  {
    Guard g;
    *lp = gLive;
    *sp = gSettings;
  }
  const ChannelLive& B = L.ch[ENGINE_CH];
  JsonDocument d;
  JsonObject c = d["comm"].to<JsonObject>();
  c["ok"] = B.commOk;
  c["okCount"] = B.okCount;
  c["errCount"] = B.errCount;
  c["err"] = JsonString(B.lastErr);
  setNum(d["pv"], B.pvValid ? B.pv : NAN);
  d["pvFlag"] = Controller::flagName(B.pvFlag);
  setNum(d["spEff"], B.spEffValid ? B.spEff : NAN);
  setNum(d["out"], B.outValid ? B.out : NAN);
  if (B.statusValid) {
    d["status"] = B.status;
    if (S.ch[ENGINE_CH].mb.profile == PROFILE_PMA_KS4X) d["mode"] = pmaModeText(B.status);
  }
  if (B.alarmValid) d["alarm"] = B.alarm;
  JsonObject r = d["run"].to<JsonObject>();
  runStatusJson(r, L);
  JsonObject m = d["manual"].to<JsonObject>();
  m["on"] = B.manualOn;
  setNum(m["sp"], S.ch[ENGINE_CH].manualSp);
  m["synced"] = B.manualSynced;
  d["sel"] = S.selProgram;
  {
    ProgSummary ps;
    const bool used = programSummary(S.selProgram, ps);
    d["selName"] = used ? ps.name : "";
    d["selSteps"] = used ? ps.items : 0;
    d["plannedTotal"] = used ? ps.total : 0;
  }
  d["spConfigured"] = S.ch[ENGINE_CH].mb.reg.sp != REG_UNSET;
  d["profile"] = S.ch[ENGINE_CH].mb.profile;
  d["net"] = netInfo();
  d["uptime"] = millis() / 1000;
  d["fw"] = FW_VERSION;
  d["board"] = BOARD_NAME;
  d["variant"] = BOARD_VARIANT;
  // both channels (the fields above are the bottom channel, for the old page)
  JsonArray chs = d["channels"].to<JsonArray>();
  for (int i = 0; i < NUM_CHANNELS; ++i) {
    const ChannelLive& C = L.ch[i];
    JsonObject o = chs.add<JsonObject>();
    o["name"] = JsonString(C.name);
    o["type"] = channelTypeName(C.type);
    o["ok"] = C.commOk;
    o["err"] = JsonString(C.lastErr);
    setNum(o["pv"], C.pvValid ? C.pv : NAN);
    o["pvFlag"] = Controller::flagName(C.pvFlag);
    setNum(o["sp"], C.spEffValid ? C.spEff : NAN);
    setNum(o["out"], C.outValid ? C.out : NAN);
    o["outOn"] = C.outOn;
    if (C.statusValid && C.type == CH_MODBUS && S.ch[i].mb.profile == PROFILE_PMA_KS4X) o["mode"] = pmaModeText(C.status);
    if (C.type == CH_LOCAL) {
      setNum(o["cold"], C.coldC);
      tuneJson(o, i);
    }
    o["fault"] = C.fault ? C.faultText : "";
    JsonObject m = o["manual"].to<JsonObject>();
    m["on"] = C.manualOn;
    setNum(m["sp"], S.ch[i].manualSp);
    m["synced"] = C.manualSynced;
  }
  sendJson(d);
}

// The whole live history (one row per slot), streamed. ?pv=3&sp=3: channels (bit 0 bottom, bit 1
// top) whose PV (+ lowest, highest) / setpoint columns are included (default all)
static void handleHistCsv() {
  const uint8_t pvMask = reqHas("pv") ? (uint8_t)(reqArg("pv").toInt() & 3) : 3;
  const uint8_t spMask = reqHas("sp") ? (uint8_t)(reqArg("sp").toInt() & 3) : 3;
  extraHeaders = "Content-Disposition: attachment; filename=tempctl-duo-history.csv\r\nCache-Control: no-store\r\n";
  uint32_t from = 0;
  bool head = true;
  sendStream("text/csv", "history.csv", [&](char* b, size_t n) -> size_t {
    if (head) {
      head = false;
      static const char* const K[NUM_CHANNELS] = {"bottom", "top"};
      int w = snprintf(b, n, "time_s,uptime_s");
      for (int c = 0; c < NUM_CHANNELS; ++c) {
        if (pvMask & (1 << c)) w += snprintf(b + w, n - w, ",%s_pv,%s_min,%s_max", K[c], K[c], K[c]);
        if (spMask & (1 << c)) w += snprintf(b + w, n - w, ",%s_sp", K[c]);
      }
      w += snprintf(b + w, n - w, "\n");
      return w;
    }
    return liveCsv(from, b, n, pvMask, spMask);
  });
}

// Log of the last program run (if there was one since boot), else the live history. Both channels.
static void handleCsv() {
  bool run;
  {
    Guard g;
    run = gHist->runValid;
  }
  if (!run) return handleHistCsv();
  String out = "time_s,bottom_pv,bottom_sp,bottom_plan,top_pv,top_sp,top_plan\n";
  out.reserve(CHART_N * 48 + 80);
  char line[112];
  auto num = [](char* b, size_t n, float v) {
    if (isnan(v)) b[0] = 0;
    else snprintf(b, n, "%.1f", v);
  };
  {
    Guard g;  // build the text under the lock, send it afterwards
    for (int i = 0; i < CHART_N; ++i) {
      float v[6];
      for (int c = 0; c < NUM_CHANNELS; ++c) {
        v[c * 3] = gHist->runPv[c][i];
        v[c * 3 + 1] = gHist->runSp[c][i];
        v[c * 3 + 2] = gHist->runPlan[c][i];
      }
      if (isnan(v[0]) && isnan(v[1]) && isnan(v[3]) && isnan(v[4])) continue;
      const float t = i * gHist->runBin;
      char f[6][12];
      for (int k = 0; k < 6; ++k) num(f[k], sizeof(f[k]), v[k]);
      snprintf(line, sizeof(line), "%.0f,%s,%s,%s,%s,%s,%s\n", t, f[0], f[1], f[2], f[3], f[4], f[5]);
      out += line;
    }
  }
  extraHeaders = "Content-Disposition: attachment; filename=tempctl-duo-run.csv\r\n";
  sendText(200, "text/csv", out);
}

// ------------------------------------------------------------ program / commands
static void handleGetPrograms() {
  static PSRAM_VAR(ProgSummary[PROG_MAX], list);
  programSummaries(list);
  JsonDocument d;
  {
    Guard g;
    d["sel"] = gSettings.selProgram;
    d["spMin"] = gSettings.ch[ENGINE_CH].spMin;
    d["spMax"] = gSettings.ch[ENGINE_CH].spMax;
  }
  d["max"] = PROG_MAX;
  d["maxPhases"] = PROG_MAX_PHASES;
  d["maxSteps"] = PROG_MAX_STEPS;
  JsonArray a = d["programs"].to<JsonArray>();
  for (int i = 0; i < PROG_MAX; ++i) {
    const ProgSummary& p = list[i];
    JsonObject o = a.add<JsonObject>();
    o["used"] = p.used != 0;
    if (!p.used) {
      char n[16];
      snprintf(n, sizeof(n), "Program %d", i + 1);
      o["name"] = n;
      o["steps"] = 0;
      o["total"] = 0;
      continue;
    }
    o["name"] = JsonString(p.name);
    o["type"] = progTypeName(p.type);
    o["steps"] = p.items;  // phases (Sequence) / steps of both channels (Timeline)
    o["total"] = p.total;
    o["waits"] = p.waits != 0;
    JsonArray u = o["uses"].to<JsonArray>();
    u.add((p.uses & 1) != 0);
    u.add((p.uses & 2) != 0);
  }
  sendJson(d);
}

static int progIndexArg(JsonVariantConst v) {
  if (!v.isNull()) return v.as<int>();
  if (reqHas("i")) return reqArg("i").toInt();
  Guard g;
  return gSettings.selProgram;
}

// {"i":0,"used":true,"program":{Duo program JSON}}
static void sendProgram(int i) {
  ScratchProg sp;
  if (!sp) return sendError("Out of memory", 500);
  DuoProgram& p = *sp;
  char err[96];
  const bool used = programLoad(i, p, err, sizeof(err));
  JsonDocument d;
  d["i"] = i;
  d["used"] = used;
  if (used) progToJson(p, d["program"].to<JsonObject>());
  sendJson(d);
}

static void handleGetProgram() {
  const int i = progIndexArg(JsonVariantConst());
  if (i < 0 || i >= PROG_MAX) return sendError("Program index out of range");
  sendProgram(i);
}

// Body: {"i":0,"program":{"fmt":1,"name":"...","type":"seq","phases":[...]}}  (spec 9.3.5)
//       {"i":0,"delete":true}
static void handlePostProgram() {
  JsonDocument d;
  if (!parseBody(d)) return sendError("Invalid JSON");
  const int i = progIndexArg(d["i"]);
  if (i < 0 || i >= PROG_MAX) return sendError("Program index out of range");
  if (d["delete"] | false) {
    if (!programDelete(i)) return sendError("Deleting the program failed", 500);
    return sendProgram(i);
  }
  if (!d["program"].is<JsonObjectConst>()) return sendError("program missing");
  ScratchProg sp;
  if (!sp) return sendError("Out of memory", 500);
  DuoProgram& p = *sp;
  char err[128];
  const char* names[NUM_CHANNELS];
  float lo[NUM_CHANNELS], hi[NUM_CHANNELS];
  static char nameBuf[NUM_CHANNELS][CH_NAME_LEN];
  {
    Guard g;
    for (int c = 0; c < NUM_CHANNELS; ++c) {
      strlcpy(nameBuf[c], gSettings.ch[c].name, sizeof(nameBuf[c]));
      names[c] = nameBuf[c];
      lo[c] = gSettings.ch[c].spMin;
      hi[c] = gSettings.ch[c].spMax;
    }
  }
  if (!progFromJson(d["program"].as<JsonObjectConst>(), p, err, sizeof(err), names)) return sendError(err);
  if (!progCheckLimits(p, lo, hi, err, sizeof(err), names)) return sendError(err);
  if (!programSave(i, p, err, sizeof(err))) return sendError(err, 500);
  sendProgram(i);
}

static void handleSelect() {
  JsonDocument d;
  if (!parseBody(d)) return sendError("Invalid JSON");
  const int i = d["i"] | -1;
  if (i < 0 || i >= PROG_MAX) return sendError("Program index out of range");
  selectProgram(i);
  JsonDocument r;
  r["ok"] = true;
  r["sel"] = i;
  sendJson(r);
}

// GET: the running (or last) program's running copy, with its run edits
static void handleGetRun() {
  std::unique_ptr<LiveData> lp(new (std::nothrow) LiveData());
  if (!lp) return sendError("Out of memory - try again", 503);
  {
    Guard g;
    *lp = gLive;
  }
  JsonDocument d;
  runStatusJson(d["run"].to<JsonObject>(), *lp);
  if (!runProgramJson(d["program"].to<JsonObject>())) d.remove("program");
  sendJson(d);
}

// Run control and run edits (spec 9.3.4); results in /api/status run.msg
//   {"cmd":"extend","ch":0,"sec":30}           current hold +30 s (Sequence: ch ignored)
//   {"cmd":"hold","ch":1,"idx":4,"sec":45}      hold time of phase / step idx (-1 = current)
//   {"cmd":"ramp","ch":1,"idx":5,"sec":40}      later ramps only
//   {"cmd":"target","ch":0,"idx":-1,"t":170}    current / kept target (or a later one)
//   {"cmd":"save"}                              store the run edits into the program
//   {"cmd":"discard"}                           keep the stored program (answers the question)
//   {"cmd":"next"} / {"cmd":"continue"}
//   {"cmd":"start","i":0,"program":{...}}      start slot 0 with this (unsaved) content
static void handlePostRun() {
  JsonDocument d;
  if (!parseBody(d)) return sendError("Invalid JSON");
  const char* c = d["cmd"] | "";
  const int ch = d["ch"] | 0;
  const int idx = d["idx"] | -1;
  bool ok;
  if (!strcmp(c, "extend")) ok = sendCmd(CMD_RUN_EDIT, ch, d["sec"] | 0.0f, -1, EDIT_EXTEND);
  else if (!strcmp(c, "hold")) ok = sendCmd(CMD_RUN_EDIT, ch, d["sec"] | 0.0f, idx, EDIT_HOLD);
  else if (!strcmp(c, "ramp")) ok = sendCmd(CMD_RUN_EDIT, ch, d["sec"] | 0.0f, idx, EDIT_RAMP);
  else if (!strcmp(c, "target")) {
    if (!d["t"].is<float>()) return sendError("t (target) missing");
    ok = sendCmd(CMD_RUN_EDIT, ch, d["t"].as<float>(), idx, EDIT_TARGET);
  } else if (!strcmp(c, "save")) ok = sendCmd(CMD_SAVE_RUN);
  else if (!strcmp(c, "discard")) ok = sendCmd(CMD_DISCARD_RUN);
  else if (!strcmp(c, "start")) {  // "Start without saving": {"cmd":"start","i":n,"program":{...}}
    const int i = d["i"] | -1;
    if (i < 0 || i >= PROG_MAX) return sendError("Program index out of range");
    ScratchProg sp;
    if (!sp) return sendError("Out of memory", 500);
    DuoProgram& p = *sp;
    char err[128];
    const char* names[NUM_CHANNELS];
    float lo[NUM_CHANNELS], hi[NUM_CHANNELS];
    static char nameBuf[NUM_CHANNELS][CH_NAME_LEN];
    {
      Guard g;
      for (int c = 0; c < NUM_CHANNELS; ++c) {
        strlcpy(nameBuf[c], gSettings.ch[c].name, sizeof(nameBuf[c]));
        names[c] = nameBuf[c];
        lo[c] = gSettings.ch[c].spMin;
        hi[c] = gSettings.ch[c].spMax;
      }
    }
    if (!progFromJson(d["program"].as<JsonObjectConst>(), p, err, sizeof(err), names)) return sendError(err);
    if (!progCheckLimits(p, lo, hi, err, sizeof(err), names)) return sendError(err);
    ok = startDraft(i, p);
  }
  else if (!strcmp(c, "next")) ok = sendCmd(CMD_NEXT);
  else if (!strcmp(c, "continue")) ok = sendCmd(CMD_CONTINUE);
  else if (!strcmp(c, "recover")) ok = sendCmd(CMD_RUN_RECOVER);  // resume the run interrupted by a reset
  else if (!strcmp(c, "dismiss")) ok = sendCmd(CMD_RUN_DISMISS);
  else return sendError("cmd must be extend, hold, ramp, target, save, start, next, continue, recover or dismiss");
  JsonDocument r;
  r["ok"] = ok;
  sendJson(r);
}

// Body: {"sp":150.0} and/or {"on":true|false}
static void handleManual() {
  JsonDocument d;
  if (!parseBody(d)) return sendError("Invalid JSON");
  const int ch = d["ch"] | (int)ENGINE_CH;  // 0 = bottom (default), 1 = top
  if (ch < 0 || ch >= NUM_CHANNELS) return sendError("ch must be 0 (bottom) or 1 (top)");
  if (!d["sp"].isNull()) setManualSp(d["sp"].as<float>(), ch);
  bool ok = true;
  if (!d["on"].isNull()) ok = sendCmd(d["on"].as<bool>() ? CMD_MANUAL_ON : CMD_MANUAL_OFF, ch);
  JsonDocument r;
  r["ok"] = ok;
  sendJson(r);
}

// {"ch":0}: acknowledge a channel's latched fault (runaway, sensor, over temperature)
static void handleAck() {
  JsonDocument d;
  if (!parseBody(d)) return sendError("Invalid JSON");
  const int ch = d["ch"] | -1;
  if (ch < 0 || ch >= NUM_CHANNELS) return sendError("ch must be 0 (bottom) or 1 (top)");
  JsonDocument r;
  r["ok"] = sendCmd(CMD_ACK_FAULT, ch);
  sendJson(r);
}

// PID autotune of a local channel:
//   {"ch":1,"cmd":"start","sp":200}  relay test around 200 degC
//   {"ch":1,"cmd":"stop"}
//   {"ch":1,"cmd":"accept"}          take the proposed kp/ki/kd into the settings
//   {"ch":1,"cmd":"discard"}
static void handleAutotune() {
  JsonDocument d;
  if (!parseBody(d)) return sendError("Invalid JSON");
  const int ch = d["ch"] | -1;
  if (ch < 0 || ch >= NUM_CHANNELS) return sendError("ch must be 0 (bottom) or 1 (top)");
  const char* cmd = d["cmd"] | "";
  JsonDocument r;
  if (!strcmp(cmd, "start")) {
    const float sp = d["sp"] | NAN;
    if (isnan(sp)) return sendError("sp (test temperature) missing");
    r["ok"] = sendCmd(CMD_TUNE_START, ch, sp);
  } else if (!strcmp(cmd, "stop")) {
    r["ok"] = sendCmd(CMD_TUNE_STOP, ch);
  } else if (!strcmp(cmd, "accept") || !strcmp(cmd, "discard")) {
    LocalTune t;
    localCtrlTuneGet(ch, t);
    if (t.state == TuneState::Running) return sendError("autotune is still running");
    if (!strcmp(cmd, "accept")) {
      if (t.state != TuneState::Done) return sendError("no autotune result to accept");
      {
        Guard g;
        LocalChannelSettings& l = gSettings.ch[ch].loc;
        l.kp = t.res.kp;
        l.ki = t.res.ki;
        l.kd = t.res.kd;
      }
      saveSettingsAndNotify();
      r["kp"] = t.res.kp;
      r["ki"] = t.res.ki;
      r["kd"] = t.res.kd;
    }
    localCtrlTuneClear(ch);
    r["ok"] = true;
  } else {
    return sendError("cmd must be start, stop, accept or discard");
  }
  sendJson(r);
}

static void handleCmd() {
  JsonDocument d;
  if (!parseBody(d)) return sendError("Invalid JSON");
  const String c = d["cmd"] | "";
  CmdType t;
  int arg = d["prog"] | -1;
  if (c == "start") t = CMD_START;
  else if (c == "pause") t = CMD_PAUSE;
  else if (c == "resume") t = CMD_RESUME;
  else if (c == "stop") t = CMD_STOP;
  else if (c == "skip" || c == "next") t = CMD_NEXT;  // "skip": old page
  else if (c == "continue") t = CMD_CONTINUE;
  else return sendError("Unknown command");
  JsonDocument r;
  r["ok"] = sendCmd(t, arg);
  sendJson(r);
}

// ------------------------------------------------------------ settings document (Duo)
// GET: the whole settings JSON (/duo/settings.json without passwords).
// POST: a partial document; only the keys given are changed, e.g.
//   {"channels":[null,{"type":"modbus","modbus":{"addr":2}}]}
static void handleGetConfig() {
  JsonDocument d;
  {
    ScratchSettings S;
    if (!S) return sendError("Out of memory", 500);
    {
      Guard g;
      *S = gSettings;
    }
    settingsToJson(*S, d.to<JsonObject>(), true);
  }
  // what this board variant can wire (not part of the settings; ignored when posted back)
  const BoardLimits lim = boardLimits();
  JsonObject l = d["limits"].to<JsonObject>();
  l["rs485"] = lim.rs485;
  l["localMax"] = lim.localMax;
  l["relay"] = localCtrlRelayWired();
  l["estop"] = safetyEstopWired();
  l["sound"] = safetySoundWired();
  l["chipTemp"] = safetyChipTempWired();
  sendJson(d);
}

static void handlePostConfig() {
  JsonDocument d;
  if (!parseBody(d)) return sendError("Invalid JSON");
  {
    ScratchSettings S;
    if (!S) return sendError("Out of memory", 500);
    char msg[200];
    {
      Guard g;
      *S = gSettings;
    }
    if (!settingsFromJson(d.as<JsonObjectConst>(), *S, msg, sizeof(msg))) return sendError(msg);
    // {"channels":[{"modbus":{"loadDefaults":true}}]}: register map of the (new) profile
    JsonArrayConst chs = d["channels"];
    for (int i = 0; i < NUM_CHANNELS && i < (int)chs.size(); ++i)
      if (chs[i]["modbus"]["loadDefaults"] | false) regMapDefaults(S->ch[i].mb.reg, S->ch[i].mb.profile);
    if (!settingsValidate(*S, boardLimits(), msg, sizeof(msg))) return sendError(msg);
    {
      Guard g;
      gSettings = *S;
    }
  }
  d.clear();
  saveSettingsAndNotify();
  handleGetConfig();
}

static void handleWifi() {
  JsonDocument d;
  if (!parseBody(d)) return sendError("Invalid JSON");
  {
    Guard g;
    if (d["ssid"].is<const char*>()) strlcpy(gSettings.ssid, d["ssid"], sizeof(gSettings.ssid));
    if (d["pass"].is<const char*>()) strlcpy(gSettings.pass, d["pass"], sizeof(gSettings.pass));
    if (d["apPass"].is<const char*>()) {
      const char* ap = d["apPass"];
      if (strlen(ap) >= 8) strlcpy(gSettings.apPass, ap, sizeof(gSettings.apPass));
    }
  }
  saveSettingsQuiet();
  JsonDocument r;
  r["ok"] = true;
  r["msg"] = "Saved. Connecting... If the address changes, reopen the page at the new IP or http://<host name>.local";
  sendJson(r);
  delay(300);  // let the response go out before the station reconnects
  netApplyWifi();
}

// GET /api/wifiscan?start=1 starts a scan; without start: {"busy":true} while scanning, then
// {"networks":[...]} (strongest first; kept until the next scan)
static void handleWifiScan() {
  static String last;     // names of the last scan, '\n'-separated
  static bool have = false;
  if (reqHas("start") && !netScanBusy()) {
    netScanStart();
    have = false;
  }
  JsonDocument d;
  if (netScanBusy()) {
    static PSRAM_VAR(char[1200], buf);
    const int n = netScanResult(buf, sizeof(buf));
    if (n == -1) {
      d["busy"] = true;
      return sendJson(d);
    }
    last = n >= 0 ? String(buf) : String();
    have = n >= 0;
    if (n < 0) d["err"] = "Scan failed";
  }
  JsonArray a = d["networks"].to<JsonArray>();
  if (have) {
    int from = 0;
    while (from < (int)last.length()) {
      int e = last.indexOf('\n', from);
      if (e < 0) e = last.length();
      if (e > from) a.add(last.substring(from, e));
      from = e + 1;
    }
  }
  sendJson(d);
}

// POST /api/brightness {"v":128}: touch screen brightness while the web slider is dragged
// (applied by the UI loop, not saved; the slider saves through /api/config when released)
static void handleBrightness() {
  JsonDocument d;
  if (!parseBody(d)) return sendError("Invalid JSON");
  int v = d["v"] | -1;
  if (v < 0) return sendError("v missing");
  if (v < 10) v = 10;
  if (v > 255) v = 255;
  {
    Guard g;
    gSettings.brightness = (uint8_t)v;
  }
  JsonDocument r;
  r["ok"] = true;
  sendJson(r);
}

// POST /api/restart (refused while a program runs)
static uint32_t restartAt = 0;
static void handleRestart() {
  bool active;
  {
    Guard g;
    active = gLive.state == RunState::Running || gLive.state == RunState::Paused;
  }
  if (active) return sendError("A program is running - stop it first");
  JsonDocument r;
  r["ok"] = true;
  sendJson(r);
  restartAt = millis() + 600;  // let the answer go out first
  if (!restartAt) restartAt = 1;
}

// POST /api/screen/restart: display and touch controller set up again (not the device); the result
// is in the serial log ("[ui] screen restart", "[touch] ...", "[lcd] ...")
static void handleScreenRestart() {
  uiScreenRestart("from the web page");
  JsonDocument r;
  r["ok"] = true;
  sendJson(r);
}

// ------------------------------------------------------------ bus tools
// Optional "ch" (query or JSON body): channel whose controller is used, 0 = bottom (default), 1 = top
static uint8_t argCh() {
  const long c = reqHas("ch") ? reqArg("ch").toInt() : 0;
  return (c >= 0 && c < NUM_CHANNELS) ? (uint8_t)c : 0;
}
static uint8_t bodyCh(const JsonDocument& b) {
  const int c = b["ch"] | 0;
  return (c >= 0 && c < NUM_CHANNELS) ? (uint8_t)c : 0;
}

static void handleMbRead() {
  BusRequest r{};
  r.ch = argCh();
  r.op = BUS_READ;
  r.addr = reqArg("addr").toInt();
  r.count = reqHas("n") ? reqArg("n").toInt() : 1;
  r.fn = reqHas("fn") ? reqArg("fn").toInt() : 0;
  if (r.fn != 0 && r.fn != 3 && r.fn != 4) r.fn = 0;
  const bool ok = busRequest(r);
  JsonDocument d;
  d["ok"] = ok;
  if (!ok) d["err"] = r.err;
  JsonArray a = d["values"].to<JsonArray>();
  for (int i = 0; i < r.n; ++i) a.add(r.values[i]);
  sendJson(d);
}

static void handleMbWrite() {
  JsonDocument b;
  if (!parseBody(b)) return sendError("Invalid JSON");
  BusRequest r{};
  r.ch = bodyCh(b);
  r.op = BUS_WRITE;
  r.addr = b["addr"] | 0;
  r.value = b["value"] | 0;
  const bool ok = busRequest(r);
  JsonDocument d;
  d["ok"] = ok;
  if (!ok) d["err"] = r.err;
  sendJson(d);
}

// ------------------------------------------------------------ background bus tools
// The find-setpoint scan (up to 20 s) and reading all PMA parameters (up to 3 s each) take too long to wait
// for in a handler: the loop task (touch screen, web) would stand still. The handler starts a job and
// answers {"busy":true,...}; webLoop() moves it on; the page asks again (GET) until the result comes.
// One job at a time; a result not fetched within 60 s is dropped.
enum : uint8_t { JOB_NONE, JOB_FINDSP, JOB_PARAMS };
static struct {
  uint8_t kind = JOB_NONE;
  uint8_t ch = 0;
  bool running = false, waiting = false;  // waiting: a request is with the control task
  int i = 0, n = 0;                       // parameters: next / count
  uint16_t want = 0;                      // find-SP: the requested end address
  float scale = 1;
  uint32_t doneAt = 0;
  BusRequest r;
  JsonDocument res;                       // parameters: the answer being built
} job;

static void jobClear() {
  job.kind = JOB_NONE;
  job.running = job.waiting = false;
  job.res.clear();
}

static void paramsAnswerStart(bool supported) {
  job.res.clear();
  job.res["supported"] = supported;
  job.res["params"].to<JsonArray>();
  JsonArray aa = job.res["actions"].to<JsonArray>();
  if (supported) {
    int n;
    const ActionDef* a = pmaActions(n);
    for (int i = 0; i < n; ++i) aa.add(a[i].label);
  }
}

static void jobStep() {
  if (job.kind == JOB_NONE) return;
  if (!job.running) {
    if (millis() - job.doneAt > 60000) jobClear();
    return;
  }
  if (job.waiting) {
    if (busCheck(job.r) == 0) return;
    job.waiting = false;
    if (job.kind == JOB_FINDSP) {
      job.running = false;
      job.doneAt = millis();
      return;
    }
    // a parameter's value
    int n;
    const ParamDef* p = pmaParams(n);
    JsonObject o = job.res["params"].as<JsonArray>().add<JsonObject>();
    const ParamDef& d = p[job.i];
    o["name"] = d.name;
    o["addr"] = d.addr;
    o["scaled"] = d.scaled != 0;
    o["desc"] = d.desc;
    if (job.r.ok) {
      const int16_t raw = job.r.values[0];
      if (Controller::classify(raw) == VAL_OFF) o["value"] = "off";
      else if (d.scaled) o["value"] = raw / job.scale;
      else o["value"] = raw;
    } else {
      o["err"] = job.r.err;
    }
    ++job.i;
  }
  if (job.kind == JOB_PARAMS) {
    if (job.i >= job.n) {
      job.running = false;
      job.doneAt = millis();
      return;
    }
    int n;
    const ParamDef* p = pmaParams(n);
    BusRequest r{};
    r.ch = job.ch;
    r.op = BUS_READ;
    r.addr = p[job.i].addr;
    r.count = 1;
    job.r = r;
    if (!busStart(job.r, 3000)) return;  // (a tool of the touch screen or console runs: next time)
    job.waiting = true;
  }
}

static void jobBusy() {
  JsonDocument d;
  d["busy"] = true;
  if (job.kind == JOB_PARAMS) {
    d["done"] = job.i;
    d["total"] = job.n;
  }
  sendJson(d);
}

// POST {"ch","from","to"}: starts the scan ({"busy":true}); GET: {"busy":true} while it runs, then the result
// {"ok","err","stoppedAt" (the time limit stopped it there: scan on from stoppedAt + 1),"reference",
// "candidates"} ({"busy":false,"none":true}: none started)
static void handleFindSp() {
  if (job.kind != JOB_NONE && job.running)
    return job.kind == JOB_FINDSP ? jobBusy() : sendError("Another bus tool is running - try again", 503);
  JsonDocument b;
  parseBody(b);
  BusRequest r{};
  r.ch = bodyCh(b);
  r.op = BUS_FINDSP;
  {
    Guard g;
    r.from = b["from"] | gSettings.scanFrom;
    r.to = b["to"] | gSettings.scanTo;
  }
  jobClear();
  job.r = r;
  job.want = r.to;
  if (!busStart(job.r, 30000)) return sendError("Bus tool busy - try again", 503);  // (the scan stops after 20 s)
  job.kind = JOB_FINDSP;
  job.ch = r.ch;
  job.running = job.waiting = true;
  return jobBusy();
}
static void handleFindSpResult() {
  if (job.kind != JOB_FINDSP) {
    JsonDocument d;
    d["busy"] = false;
    d["none"] = true;
    return sendJson(d);
  }
  if (job.running) return jobBusy();
  const BusRequest& r = job.r;
  JsonDocument d;
  d["ok"] = r.ok;
  if (!r.ok) d["err"] = r.err;
  else if (r.to < job.want && r.to >= r.from) d["stoppedAt"] = r.to;
  d["reference"] = r.refValue;
  JsonArray a = d["candidates"].to<JsonArray>();
  for (int i = 0; i < r.n; ++i) a.add((uint16_t)r.values[i]);
  jobClear();
  sendJson(d);
}

// ------------------------------------------------------------ controller parameters
// GET ?ch=n: the PMA parameters of channel n, read one after the other in the background: {"busy":true,
// "done","total"} until all are read, then {"supported","params":[{"name","addr","scaled","desc","value" or
// "err"}],"actions"}. Asking again while a finished answer for the channel waits returns it.
static void handleGetParams() {
  const uint8_t ch = argCh();
  if (job.kind == JOB_PARAMS && job.ch == ch) {
    if (job.running) return jobBusy();
    String out;
    serializeJson(job.res, out);
    jobClear();
    return sendText(200, "application/json", out);
  }
  if (job.kind != JOB_NONE && job.running) return sendError("Another bus tool is running - try again", 503);
  uint8_t profile;
  float scale;
  {
    Guard g;
    profile = gSettings.ch[ch].mb.profile;
    scale = gSettings.ch[ch].mb.reg.scale;
  }
  jobClear();
  paramsAnswerStart(profile == PROFILE_PMA_KS4X);
  if (profile != PROFILE_PMA_KS4X) {  // nothing to read
    String out;
    serializeJson(job.res, out);
    jobClear();
    return sendText(200, "application/json", out);
  }
  job.kind = JOB_PARAMS;
  job.ch = ch;
  job.scale = scale > 0 ? scale : 1;
  pmaParams(job.n);
  job.i = 0;
  job.running = true;
  jobStep();  // (the first request)
  jobBusy();
}

static void handlePostParam() {
  JsonDocument b;
  if (!parseBody(b)) return sendError("Invalid JSON");
  float scale;
  const uint8_t ch = bodyCh(b);
  {
    Guard g;
    scale = gSettings.ch[ch].mb.reg.scale;
  }
  BusRequest r{};
  r.ch = ch;
  r.op = BUS_WRITE;
  r.addr = b["addr"] | 0;
  const bool scaled = b["scaled"] | false;
  const String v = b["value"].is<const char*>() ? String((const char*)b["value"]) : String(b["value"].as<float>());
  if (v == "off") r.value = -32000;
  else r.value = (int16_t)lroundf(v.toFloat() * (scaled ? scale : 1.0f));
  // only allow addresses from the parameter table
  int n;
  const ParamDef* p = pmaParams(n);
  bool allowed = false;
  for (int i = 0; i < n; ++i) allowed |= p[i].addr == r.addr && strcmp(p[i].name, "Sw.Op") != 0;
  if (!allowed) return sendError("Address is not an editable parameter");
  const bool ok = busRequest(r);
  JsonDocument d;
  d["ok"] = ok;
  if (!ok) d["err"] = r.err;
  sendJson(d);
}

// ------------------------------------------------------------ firmware update (spec 9.11)
static void otaStatusJson(JsonObject o) {
  OtaStatus st;
  otaStatus(st);
  static const char* const PH[] = {"idle", "running", "done", "failed"};
  o["phase"] = PH[st.phase <= OTA_FAILED ? st.phase : 0];
  o["source"] = st.source == OTA_SD ? "sd" : st.source == OTA_WEB ? "web" : st.source == OTA_NET ? "net" : "";
  o["done"] = st.done;
  o["total"] = st.total;
  o["version"] = JsonString(st.version);
  o["msg"] = JsonString(st.msg);
}

// GET /api/ota: what can be updated
static void handleOtaInfo() {
  JsonDocument d;
  d["board"] = BOARD_ID;
  d["version"] = FW_VERSION;
  d["slot"] = otaRunningSlot();
  uint32_t size;
  char why[120];
  const bool slot = otaSlot(size, why, sizeof(why));
  d["slotKb"] = slot ? size / 1024 : 0;
  char err[120] = "";
  d["canStart"] = otaCanStart(err, sizeof(err));
  if (err[0]) d["why"] = err;
  d["probation"] = otaProbation();
  d["sd"] = sdlogSlot();
  otaStatusJson(d["status"].to<JsonObject>());
  sendJson(d);
}

// POST /api/ota?size=<bytes>[&md5=<32 hex>] (multipart, field "fw"): the upload is written while it arrives; the answer
// comes when it is complete; the device restarts 2 s later
static char otaErr[120];
static void handleOtaUpload() {
  HTTPUpload& u = server.upload();
  esp_task_wdt_reset();  // (the whole upload runs inside one handleClient() of the loop task)
  switch (u.status) {
    case UPLOAD_FILE_START: {
      otaErr[0] = 0;
      if (!postHeaderOk() || !hostOk()) {  // (refused; the data is read and dropped, the answer is 403)
        strlcpy(otaErr, "POST needs the header X-TempCtl: 1", sizeof(otaErr));
        break;
      }
      safetyActivity();
      const uint32_t size = (uint32_t)server.arg("size").toInt();
      if (otaBegin(OTA_WEB, size, otaErr, sizeof(otaErr)) && server.hasArg("md5"))
        otaSetMd5(server.arg("md5").c_str());  // (from the release list: checked when the image is complete)
      break;
    }
    case UPLOAD_FILE_WRITE: {
      if (!otaErr[0] && !otaWrite(u.buf, u.currentSize)) {
        OtaStatus st;
        otaStatus(st);
        strlcpy(otaErr, st.msg, sizeof(otaErr));
      }
      static uint32_t drawn = 0;
      if (millis() - drawn > 300) {  // the touch screen's progress overlay
        drawn = millis();
        uiOtaRefresh();
      }
      break;
    }
    case UPLOAD_FILE_END:
      if (!otaErr[0]) otaEnd(otaErr, sizeof(otaErr));
      break;
    case UPLOAD_FILE_ABORTED:
      if (!otaErr[0]) {
        otaAbort("the upload was interrupted");
        strlcpy(otaErr, "the upload was interrupted", sizeof(otaErr));
      }
      break;
  }
}
static void handleOtaDone() {
  JsonDocument d;
  OtaStatus st;
  otaStatus(st);
  d["ok"] = !otaErr[0] && st.phase == OTA_DONE;
  if (otaErr[0]) d["err"] = otaErr;
  else if (st.phase != OTA_DONE) d["err"] = "no firmware file received";
  d["version"] = JsonString(st.version);
  sendJson(d);
}

// GET /api/ota/sd?start=1: starts the check of the firmware.bin on the SD card (S3; the SD task reads the whole
// file, a few seconds); GET /api/ota/sd: {"busy":true} while it runs ({"busy":false,"none":true} if none was
// started), then its result {"found",...} or {"err"}. POST /api/ota/sd: install it
static void handleOtaSdCheck() {
  SdFirmware f;
  char err[96] = "";
  if (reqHas("start") && !sdlogFirmwareCheckStart(err, sizeof(err))) return sendError(err);
  const int r = sdlogFirmwareCheckResult(f, err, sizeof(err));
  JsonDocument d;
  if (r <= 0) {
    d["busy"] = r == 0;
    if (r < 0) d["none"] = true;
    extraHeaders = "Cache-Control: no-store\r\n";
    return sendJson(d);
  }
  if (r == 2) return sendError(err);
  d["found"] = f.found;
  if (f.found) {
    d["sizeKb"] = f.size / 1024;
    d["board"] = JsonString(f.board);
    d["version"] = JsonString(f.version);
    d["problem"] = JsonString(f.problem);
  }
  sendJson(d);
}
static void handleOtaSdInstall() {
  char err[120];
  if (!sdlogFirmwareInstall(err, sizeof(err))) return sendError(err);
  JsonDocument d;
  d["ok"] = true;
  sendJson(d);
}

// POST /api/beep: one short test beep (Settings page)
static void handleBeep() {
  safetyBeepTest();
  JsonDocument d;
  d["ok"] = safetySoundWired();
  if (!safetySoundWired()) d["err"] = "no buzzer on this board";
  sendJson(d);
}

static void handleAction() {
  JsonDocument b;
  if (!parseBody(b)) return sendError("Invalid JSON");
  int n;
  const ActionDef* a = pmaActions(n);
  const int i = b["i"] | -1;
  if (i < 0 || i >= n) return sendError("Unknown action");
  BusRequest r{};
  r.ch = bodyCh(b);
  r.op = BUS_WRITE;
  r.addr = a[i].addr;
  r.value = a[i].value;
  const bool ok = busRequest(r);
  JsonDocument d;
  d["ok"] = ok;
  if (!ok) d["err"] = r.err;
  sendJson(d);
}

// ------------------------------------------------------------ new page (step 7)

static void sendAsset(const WebAsset& a) {
  extraHeaders = a.gzip ? "Content-Encoding: gzip\r\n" : "";
  extraHeaders += a.immutable ? "Cache-Control: public, max-age=31536000, immutable\r\n" : "Cache-Control: no-cache\r\n";
  sendBody(200, a.type, a.data, a.len, a.path);
}

static const char* const CH_KEYS[NUM_CHANNELS] = {"b", "t"};

// ?a0=&a1= (device millis, as GET /api/raw): the new PV readings after them, so that the page needs no
// second request per poll: "raw":[[ms, pv, ms, pv, ...], [...]] (pv in 0.1 degC, null = no reading). More
// than LIVE_RAW_MAX for a channel (a tab that was hidden): "rawMore":true instead, the page uses /api/raw.
// Not over the serial link (as /api/raw).
static constexpr uint32_t LIVE_RAW_MAX = 32;
static void liveRaw(JsonDocument& d) {
  if (sreq || !rawCap() || !reqHas("a0") || !reqHas("a1")) return;
  uint32_t after[NUM_CHANNELS];
  for (int c = 0; c < NUM_CHANNELS; ++c) {
    const char k[3] = {'a', (char)('0' + c), 0};
    after[c] = (uint32_t)strtoul(reqArg(k).c_str(), nullptr, 10);
  }
  RawPlan p;
  rawPlan(after, 0, LIVE_RAW_MAX + 1, p);
  for (int c = 0; c < NUM_CHANNELS; ++c)
    if (p.n[c] > LIVE_RAW_MAX) {
      d["rawMore"] = true;
      return;
    }
  JsonArray a = d["raw"].to<JsonArray>();
  uint8_t buf[LIVE_RAW_MAX * 8];
  for (int c = 0; c < NUM_CHANNELS; ++c) {
    JsonArray x = a.add<JsonArray>();
    const uint32_t n = rawCopy(c, p.from[c], p.n[c], buf);
    for (uint32_t k = 0; k < n; ++k) {
      const uint8_t* r = buf + k * 8;
      const uint32_t ms = (uint32_t)r[0] | (uint32_t)r[1] << 8 | (uint32_t)r[2] << 16 | (uint32_t)r[3] << 24;
      const int16_t pv = (int16_t)((uint16_t)r[4] | (uint16_t)r[5] << 8);
      if (!ms) continue;  // (overwritten meanwhile)
      x.add(ms);
      if (pv == INT16_MIN) x.add(nullptr);  // (RAW_NONE: a gap)
      else x.add(pv);
    }
  }
}

// Everything the Status page polls (1 s): both channels, run state, counters
static void handleLive() {
  // gLive (on the heap: 1 kB) and the few settings this answer needs, under the lock
  std::unique_ptr<LiveData> lp(new (std::nothrow) LiveData());
  if (!lp) return sendError("Out of memory - try again", 503);
  const LiveData& L = *lp;
  struct {
    decltype(Settings::selProgram) selProgram;
    decltype(Settings::accentColor) accentColor;
    decltype(Settings::bottomBand) bottomBand;
    decltype(Settings::pollMs) pollMs;
    char tz[sizeof(Settings::tzName)];
    struct {
      decltype(ModbusChannelSettings::profile) profile;
      float spMin, spMax, manualSp;
    } ch[NUM_CHANNELS];
  } S;
  {
    Guard g;
    *lp = gLive;
    S.selProgram = gSettings.selProgram;
    S.accentColor = gSettings.accentColor;
    S.bottomBand = gSettings.bottomBand;
    S.pollMs = gSettings.pollMs;
    strlcpy(S.tz, gSettings.tzName, sizeof(S.tz));
    for (int i = 0; i < NUM_CHANNELS; ++i) {
      S.ch[i].profile = gSettings.ch[i].mb.profile;
      S.ch[i].spMin = gSettings.ch[i].spMin;
      S.ch[i].spMax = gSettings.ch[i].spMax;
      S.ch[i].manualSp = gSettings.ch[i].manualSp;
    }
  }
  JsonDocument d;
  d["up"] = millis() / 1000;
  d["fw"] = FW_VERSION;
  d["board"] = BOARD_NAME;
  d["variant"] = BOARD_VARIANT;
  d["net"] = netInfo();
  d["sel"] = S.selProgram;
  d["progGen"] = programStoreGen();
  d["logSeq"] = logSeq();
  d["sysSeq"] = syslogSeq();   // newest system log line (System page)
  d["boot"] = syslogBoot();
  d["time"] = syslogEpoch();   // device clock (UTC s), 0 = not known: the page sets it (POST /api/time)
  d["tz"] = S.tz;  // time zone ("" = not set: the page sends the browser's)
  if (localCtrlRelayUsed()) d["relay"] = localCtrlRelayOn();  // SSR supply relay (S3, setting safety.relay on)
  {  // firmware update in progress / new firmware on probation (spec 9.11)
    OtaStatus st;
    otaStatus(st);
    if (st.phase != OTA_IDLE || otaProbation()) otaStatusJson(d["ota"].to<JsonObject>());
    if (otaProbation()) d["ota"]["probation"] = true;
  }
  {  // safety (spec 9.2a)
    JsonObject o = d["safety"].to<JsonObject>();
    o["estop"] = L.estop;           // active: all outputs forced off
    if (safetyEstopWired()) o["contact"] = L.estopRaw ? "open" : "closed";
    if (!isnan(L.chipC)) o["chipC"] = roundf(L.chipC * 10) / 10;
    o["chipHot"] = L.chipHot;
    o["muted"] = L.soundMuted;
  }
  if (sdlogSlot()) {  // SD run log (S3): the System page shows the card's run files
    SdState sd;
    sdlogState(sd);
    JsonObject o = d["sd"].to<JsonObject>();
    o["card"] = sd.card;  // 1 found, 0 not found (at the last access), -1 not tried yet
    o["logging"] = sd.logging;
    o["file"] = JsonString(sd.file);
    o["err"] = JsonString(sd.err);
  }
  d["cfgGen"] = settingsGen();
  char hex[8];
  snprintf(hex, sizeof(hex), "#%06X", (unsigned)(S.accentColor & 0xFFFFFF));
  d["accent"] = hex;
  d["band"] = S.bottomBand;
  d["pollMs"] = S.pollMs;  // the page polls this fast (250..1000 ms; a faster device interval: still 250 ms)
  JsonObject r = d["run"].to<JsonObject>();
  r["state"] = runStateName(L.state);
  r["prog"] = L.runProg;
  if (L.runProg >= 0) {
    r["name"] = JsonString(L.runName);
    r["type"] = progTypeName(L.progType);
    r["el"] = roundf(L.elapsed * 10) / 10;
    r["rem"] = roundf(L.remaining * 10) / 10;
    r["progPause"] = L.progPause;
    r["actionRequired"] = L.pauseMsg;
    r["pauseText"] = JsonString(L.pauseText);
    r["edited"] = L.runEdited;
    r["waiting"] = L.waiting;
    if (L.progType == PROG_SEQ) {
      stageJson(r["seq"].to<JsonObject>(), L.seq);
      r["phases"] = L.phases;
    }
  }
  r["msg"] = JsonString(L.runMsg);
  if (L.intrValid) {  // "Run interrupted by a reset": where it was (program = prog / name / type)
    JsonObject x = r["intr"].to<JsonObject>();
    x["reason"] = JsonString(L.intrReason);
    x["exact"] = L.intrExact;
    x["el"] = roundf(L.intrPos.el);
    JsonArray xi = x["i"].to<JsonArray>(), xs = x["st"].to<JsonArray>(), xl = x["left"].to<JsonArray>();
    for (int i = 0; i < NUM_CHANNELS; ++i) {
      xi.add(L.intrPos.i[i]);
      xs.add(stageName((Stage)L.intrPos.st[i]));
      xl.add(roundf(L.intrPos.left[i]));
    }
  }
  JsonArray a = d["ch"].to<JsonArray>();
  for (int i = 0; i < NUM_CHANNELS; ++i) {
    const ChannelLive& C = L.ch[i];
    const auto& cs = S.ch[i];
    const ChOut& o = L.run[i];
    JsonObject c = a.add<JsonObject>();
    c["key"] = CH_KEYS[i];
    c["name"] = JsonString(C.name);
    c["type"] = channelTypeName(C.type);
    c["ok"] = C.commOk;
    c["err"] = JsonString(C.lastErr);
    setNum(c["pv"], C.pvValid ? C.pv : NAN);
    c["pvFlag"] = Controller::flagName(C.pvFlag);
    setNum(c["sp"], C.spEffValid ? C.spEff : NAN);
    setNum(c["out"], C.outValid ? C.out : NAN);
    c["outOn"] = C.outOn;
    if (C.statusValid && C.type == CH_MODBUS && cs.profile == PROFILE_PMA_KS4X) c["mode"] = pmaModeText(C.status);
    if (C.type == CH_LOCAL) setNum(c["cold"], C.coldC);
    c["fault"] = C.fault ? C.faultText : "";
    c["spMin"] = cs.spMin;
    c["spMax"] = cs.spMax;
    c["inProgram"] = o.inProgram;
    c["state"] = chStateName((ChState)L.chSt[i]);
    c["idle"] = o.idle;
    setNum(c["runSp"], o.sp);
    setNum(c["target"], o.target);
    c["moving"] = o.moving;
    c["kept"] = L.kept[i];
    c["canExtend"] = L.canExt[i];
    c["synced"] = L.spSyncedCh[i];
    if (L.progType == PROG_TL && L.runProg >= 0) {
      stageJson(c["lane"].to<JsonObject>(), L.lane[i]);
      c["steps"] = L.steps[i];
    }
    JsonObject m = c["manual"].to<JsonObject>();
    m["on"] = C.manualOn;
    setNum(m["sp"], cs.manualSp);
    m["synced"] = C.manualSynced;
    if (C.type == CH_LOCAL) tuneJson(c, i);
  }
  liveRaw(d);
  sendJson(d);
}

// ?v=run: current / last run (history, lanes, events, forecast); ?v=live: rolling window
static void handleChart() {
  String out;
  if (!chartJson(out, reqArg("v") != "live")) return sendError("Out of memory - try again", 503);
  extraHeaders = "Cache-Control: no-store\r\n";
  sendText(200, "application/json", out);
}

// GET /api/raw?a0=&a1=&win=&max= : every PV reading of both channels after a0 / a1 (device millis), at most
// win s old, at most max per channel (default 8192). Binary, little-endian: uint32 now (millis), n0, n1,
// 1 (format); then n0 + n1 records of 8 bytes: uint32 millis, int16 PV (0.1 degC, -32768 = no reading),
// 2 bytes 0. Over Wi-Fi only (the serial link carries text).
static void handleRaw() {
  if (sreq) return sendError("Not over the serial link");
  uint32_t after[NUM_CHANNELS];
  for (int c = 0; c < NUM_CHANNELS; ++c) {
    const String k = String("a") + c;
    after[c] = reqHas(k.c_str()) ? (uint32_t)strtoul(reqArg(k.c_str()).c_str(), nullptr, 10) : 0;
  }
  const uint32_t win = reqHas("win") ? (uint32_t)strtoul(reqArg("win").c_str(), nullptr, 10) : 0;
  uint32_t mx = reqHas("max") ? (uint32_t)strtoul(reqArg("max").c_str(), nullptr, 10) : 8192;
  if (mx < 1) mx = 1;
  if (mx > 16384) mx = 16384;
  RawPlan p;
  rawPlan(after, win > 4000000 ? 0 : win * 1000, mx, p);
  extraHeaders = "Cache-Control: no-store\r\n";
  int stage = 0, ch = 0;
  uint32_t done = 0;
  sendStream("application/octet-stream", "raw", [&](char* b, size_t n) -> size_t {
    if (stage == 0) {
      stage = 1;
      const uint32_t h[4] = {p.nowMs, p.n[0], p.n[1], 1};
      for (int i = 0; i < 4; ++i)
        for (int k = 0; k < 4; ++k) b[i * 4 + k] = (char)(h[i] >> (8 * k));
      return 16;
    }
    while (ch < NUM_CHANNELS && done >= p.n[ch]) ch++, done = 0;
    if (ch >= NUM_CHANNELS) return 0;
    uint32_t k = (uint32_t)(n / 8);
    if (k > p.n[ch] - done) k = p.n[ch] - done;
    rawCopy(ch, p.from[ch] + done, k, (uint8_t*)b);
    done += k;
    return (size_t)k * 8;
  });
}

// ?since=n: event log entries after n
static void handleLog() {
  LogEntry* e = (LogEntry*)malloc(sizeof(LogEntry) * LOG_N);  // 5 kB, only while answering
  if (!e) return sendError("Out of memory", 500);
  const uint32_t since = reqHas("since") ? (uint32_t)reqArg("since").toInt() : 0;
  const int n = logSince(since, e, LOG_N);
  JsonDocument d;
  d["seq"] = logSeq();
  d["up"] = millis() / 1000;
  JsonArray a = d["log"].to<JsonArray>();
  for (int i = 0; i < n; ++i) {
    JsonArray x = a.add<JsonArray>();
    x.add(e[i].seq);
    x.add(e[i].upSec);
    if (isnan(e[i].runT)) x.add(nullptr);
    else x.add((int)e[i].runT);
    x.add(e[i].msg);
    x.add(e[i].kind);   // LogKind: 1 event, 2 run, 3 warning, 4 error
    x.add(e[i].epoch);  // UTC s (0: the clock was not known)
  }
  free(e);
  sendJson(d);
}

// System log (System page): ?since=n -> the lines after n, oldest first, about 12 kB at a time
// ({"more":true}: ask again); lines [seq, uptime s, epoch (0 = unknown), kind, text]
static void addSysLine(const SysLine& l, void* u) {
  JsonArray x = ((JsonArray*)u)->add<JsonArray>();
  x.add(l.seq);
  x.add(l.up);
  x.add(l.epoch);
  x.add((int)l.kind);
  x.add(JsonString(l.text));  // copied: a plain const char[] would be kept as a pointer to the reused buffer
}
static void handleSysLog() {
  const uint32_t since = reqHas("since") ? (uint32_t)reqArg("since").toInt() : 0;
  JsonDocument d;
  JsonArray a = d["lines"].to<JsonArray>();
  syslogRead(since, 12000, addSysLine, &a);
  const uint32_t last = a.size() ? (uint32_t)a[a.size() - 1][0] : since;
  d["seq"] = syslogSeq();
  d["first"] = syslogFirst();
  d["more"] = last < syslogSeq();
  d["boot"] = syslogBoot();
  d["up"] = millis() / 1000;
  d["time"] = syslogEpoch();
  extraHeaders = "Cache-Control: no-store\r\n";
  sendJson(d);
}

// Events saved in flash (all starts): lines "boot\tepoch\tuptime\tkind\ttext"
static void handleEventFile() {
  syslogFlush();  // the newest ones too
  File f = LittleFS.open(syslogFile(), "r");
  if (!f) return sendText(200, "text/plain", "");
  extraHeaders = "Cache-Control: no-store\r\n";
  sendStream("text/plain", "events.txt", [&](char* b, size_t n) -> size_t { return f.read((uint8_t*)b, n); });
  f.close();
}

// POST /api/time {"t":<UTC s>, "zone":"Europe/Berlin", "fixed":"UTC+02:00"}: the page sets the device clock
// when it has no NTP time (for the log), and the time zone while none is set (the browser's zone if the
// list has it, else its current offset)
static void handleTime() {
  JsonDocument b;
  if (!parseBody(b)) return sendError("Invalid JSON");
  if (b["t"].is<uint32_t>()) syslogSetEpoch(b["t"] | 0u);
  const char* zone = b["zone"] | "";
  const char* fixed = b["fixed"] | "";
  char rule[48];
  const char* use = tzLookup(zone, rule, sizeof(rule)) ? zone : tzLookup(fixed, rule, sizeof(rule)) ? fixed : nullptr;
  bool set = false;
  if (use) {
    Guard g;
    if (!gSettings.tzName[0] && strlen(use) < sizeof(gSettings.tzName)) {
      strlcpy(gSettings.tzName, use, sizeof(gSettings.tzName));
      set = true;
    }
  }
  if (set) {
    saveSettingsQuiet();
    logEvent("Time zone set from the browser: %s", use);
  }
  JsonDocument r;
  r["ok"] = true;
  r["time"] = syslogEpoch();
  {
    Guard g;
    r["zone"] = JsonString(gSettings.tzName);
  }
  sendJson(r);
}

// GET /api/timezones: the names the time zone setting takes (besides "UTC+hh:mm")
static void handleTimezones() {
  JsonDocument d;
  JsonArray a = d["zones"].to<JsonArray>();
  for (int i = 0; i < tzCount(); ++i) a.add(tzListName(i));  // (string literals: kept as pointers)
  sendJson(d);
}

// ------------------------------------------------------------ SD run logs (S3)
// GET /api/sd: {"slot","card","logging","file","err","totalKb","freeKb","files":[[name, size, mtime], ...]}
static void handleSdList() {
  JsonDocument d;
  d["slot"] = sdlogSlot();
  if (sdlogSlot()) {
    constexpr int MAXF = 200;
    SdFile* files = (SdFile*)heap_caps_malloc(sizeof(SdFile) * MAXF, MALLOC_CAP_SPIRAM | MALLOC_CAP_8BIT);
    if (!files) return sendError("Out of memory", 500);
    char err[64] = "";
    uint32_t total = 0, freeKb = 0;
    const int n = sdlogList(files, MAXF, total, freeKb, err, sizeof(err));
    SdState sd;
    sdlogState(sd);
    d["card"] = n >= 0;
    d["logging"] = sd.logging;
    d["file"] = JsonString(sd.file);
    d["err"] = JsonString(n < 0 ? err : sd.err);
    d["totalKb"] = total;
    d["freeKb"] = freeKb;
    JsonArray a = d["files"].to<JsonArray>();
    for (int i = 0; i < n; ++i) {
      JsonArray x = a.add<JsonArray>();
      x.add(JsonString(files[i].name));
      x.add(files[i].size);
      x.add(files[i].mtime);
    }
    free(files);
  }
  extraHeaders = "Cache-Control: no-store\r\n";
  sendJson(d);
}

// GET /api/sd/file?name=<file>: one run log (CSV)
static void handleSdFile() {
  const String name = reqArg("name");
  char err[96];
  size_t len = 0;
  char* data = sdlogLoad(name.c_str(), len, err, sizeof(err));
  if (!data) return sendError(err, 404);
  extraHeaders = String("Content-Disposition: attachment; filename=\"") + name + "\"\r\nCache-Control: no-store\r\n";
  size_t at = 0;
  sendStream("text/csv", "run log", [&](char* b, size_t n) -> size_t {
    const size_t k = len - at < n ? len - at : n;
    memcpy(b, data + at, k);
    at += k;
    return k;
  });
  free(data);
}

// POST /api/sd/delete {"name":<file>}
static void handleSdDelete() {
  JsonDocument b;
  if (!parseBody(b)) return sendError("Invalid JSON");
  char err[64];
  if (!sdlogDelete(b["name"] | "", err, sizeof(err))) return sendError(err);
  JsonDocument r;
  r["ok"] = true;
  sendJson(r);
}

// ------------------------------------------------------------ backups on the SD card (S3, spec 9.12)
// GET /api/backup: {"slot","card","err","totalKb","freeKb","files":[[name, size, mtime], ...]} newest first
static void handleBackupList() {
  JsonDocument d;
  d["slot"] = sdlogSlot();
  if (sdlogSlot()) {
    constexpr int MAXF = 100;
    SdFile* files = (SdFile*)heap_caps_malloc(sizeof(SdFile) * MAXF, MALLOC_CAP_SPIRAM | MALLOC_CAP_8BIT);
    if (!files) return sendError("Out of memory", 500);
    char err[64] = "";
    uint32_t total = 0, freeKb = 0;
    const int n = sdlogList(files, MAXF, total, freeKb, err, sizeof(err), SD_BACKUPS);
    d["card"] = n >= 0;
    d["err"] = JsonString(n < 0 ? err : "");
    d["totalKb"] = total;
    d["freeKb"] = freeKb;
    JsonArray a = d["files"].to<JsonArray>();
    for (int i = 0; i < n; ++i) {
      JsonArray x = a.add<JsonArray>();
      x.add(JsonString(files[i].name));
      x.add(files[i].size);
      x.add(files[i].mtime);
    }
    free(files);
  }
  extraHeaders = "Cache-Control: no-store\r\n";
  sendJson(d);
}

// POST /api/backup {}: a new backup -> {"ok":true,"name":...}
static void handleBackupCreate() {
  char name[64], err[120];
  if (!backupCreate(name, sizeof(name), err, sizeof(err))) return sendError(err);
  JsonDocument d;
  d["ok"] = true;
  d["name"] = JsonString(name);
  sendJson(d);
}

// GET /api/backup/info?name=: {"time","fw","settings","programs","slots":"1, 2, 5","mask"} (mask: bit k = slot k)
static void handleBackupInfo() {
  BackupInfo i;
  char err[120];
  if (!backupInfo(reqArg("name").c_str(), i, err, sizeof(err))) return sendError(err);
  JsonDocument d;
  d["time"] = JsonString(i.time);
  d["fw"] = JsonString(i.fw);
  d["settings"] = i.settings;
  d["programs"] = i.programs;
  d["slots"] = JsonString(i.slots);
  d["mask"] = i.mask;
  sendJson(d);
}

// POST /api/backup/restore {"name","settings":true,"programs":true} -> {"ok","msg"} / {"ok":false,"err"}
static void handleBackupRestore() {
  JsonDocument b;
  if (!parseBody(b)) return sendError("Invalid JSON");
  const uint8_t what = ((b["settings"] | false) ? BACKUP_SETTINGS : 0) | ((b["programs"] | false) ? BACKUP_PROGRAMS : 0);
  char msg[400];
  if (!backupRestore(b["name"] | "", what, msg, sizeof(msg))) return sendError(msg);
  JsonDocument r;
  r["ok"] = true;
  r["msg"] = JsonString(msg);
  sendJson(r);
}

// POST /api/backup/delete {"name"}
static void handleBackupDelete() {
  JsonDocument b;
  if (!parseBody(b)) return sendError("Invalid JSON");
  char err[96];
  if (!sdlogDelete(b["name"] | "", err, sizeof(err), SD_BACKUPS)) return sendError(err);
  JsonDocument r;
  r["ok"] = true;
  sendJson(r);
}

// GET /api/backup/file?name=: the file itself (JSON)
static void handleBackupFile() {
  const String name = reqArg("name");
  char err[96];
  size_t len = 0;
  char* data = sdlogLoad(name.c_str(), len, err, sizeof(err), SD_BACKUPS);
  if (!data) return sendError(err, 404);
  extraHeaders = String("Content-Disposition: attachment; filename=\"") + name + "\"\r\nCache-Control: no-store\r\n";
  size_t at = 0;
  sendStream("application/json", "backup", [&](char* b, size_t n) -> size_t {
    const size_t k = len - at < n ? len - at : n;
    memcpy(b, data + at, k);
    at += k;
    return k;
  });
  free(data);
}

// ------------------------------------------------------------ setup
// the web API: the same handlers for HTTP and for the serial api mode
struct Route {
  const char* path;
  HTTPMethod method;
  void (*fn)();
};
static const Route ROUTES[] = {
    {"/api/live", HTTP_GET, handleLive},
    {"/api/chart", HTTP_GET, handleChart},
    {"/api/raw", HTTP_GET, handleRaw},
    {"/api/log", HTTP_GET, handleLog},
    {"/api/syslog", HTTP_GET, handleSysLog},
    {"/api/eventlog.txt", HTTP_GET, handleEventFile},
    {"/api/time", HTTP_POST, handleTime},
    {"/api/timezones", HTTP_GET, handleTimezones},
    {"/api/sd", HTTP_GET, handleSdList},
    {"/api/sd/file", HTTP_GET, handleSdFile},
    {"/api/sd/delete", HTTP_POST, handleSdDelete},
    {"/api/backup", HTTP_GET, handleBackupList},
    {"/api/backup", HTTP_POST, handleBackupCreate},
    {"/api/backup/info", HTTP_GET, handleBackupInfo},
    {"/api/backup/restore", HTTP_POST, handleBackupRestore},
    {"/api/backup/delete", HTTP_POST, handleBackupDelete},
    {"/api/backup/file", HTTP_GET, handleBackupFile},
    {"/api/status", HTTP_GET, handleStatus},
    {"/api/log.csv", HTTP_GET, handleCsv},
    {"/api/history.csv", HTTP_GET, handleHistCsv},
    {"/api/programs", HTTP_GET, handleGetPrograms},
    {"/api/program", HTTP_GET, handleGetProgram},
    {"/api/program", HTTP_POST, handlePostProgram},
    {"/api/select", HTTP_POST, handleSelect},
    {"/api/run", HTTP_GET, handleGetRun},
    {"/api/run", HTTP_POST, handlePostRun},
    {"/api/manual", HTTP_POST, handleManual},
    {"/api/cmd", HTTP_POST, handleCmd},
    {"/api/ack", HTTP_POST, handleAck},
    {"/api/autotune", HTTP_POST, handleAutotune},
    {"/api/wifi", HTTP_POST, handleWifi},
    {"/api/wifiscan", HTTP_GET, handleWifiScan},
    {"/api/restart", HTTP_POST, handleRestart},
    {"/api/screen/restart", HTTP_POST, handleScreenRestart},
    {"/api/brightness", HTTP_POST, handleBrightness},
    {"/api/config", HTTP_GET, handleGetConfig},
    {"/api/config", HTTP_POST, handlePostConfig},
    {"/api/mb/read", HTTP_GET, handleMbRead},
    {"/api/mb/write", HTTP_POST, handleMbWrite},
    {"/api/mb/findsp", HTTP_POST, handleFindSp},
    {"/api/mb/findsp", HTTP_GET, handleFindSpResult},
    {"/api/params", HTTP_GET, handleGetParams},
    {"/api/params", HTTP_POST, handlePostParam},
    {"/api/action", HTTP_POST, handleAction},
    {"/api/beep", HTTP_POST, handleBeep},
    {"/api/ota", HTTP_GET, handleOtaInfo},
    {"/api/ota/sd", HTTP_GET, handleOtaSdCheck},
    {"/api/ota/sd", HTTP_POST, handleOtaSdInstall},
};

void webBegin() {
  // the page, fonts and icons (web_assets.h: the S3 has the page with web fonts at /, the CYD the one
  // without, and no font files)
  for (size_t i = 0; i < WEB_ASSET_COUNT; ++i) {
    const WebAsset* a = &WEB_ASSETS[i];
    server.on(a->path, HTTP_GET, [a] { sendAsset(*a); });
  }
  static const char* collect[] = {POST_HEADER};
  server.collectHeaders(collect, 1);
  for (const Route& r : ROUTES)
    server.on(r.path, r.method, [&r] {
      crumbWeb(r.path);  // (watchdog diagnosis: which request)
      if (!hostOk()) return sendError("Host is not this device", 403);
      if (r.method == HTTP_POST) {
        if (!postHeaderOk()) return sendError("POST needs the header X-TempCtl: 1", 403);
        safetyActivity();
      }
      r.fn();
      crumb(CR_LOOP, L_WEB);
    });
  server.on("/api/ota", HTTP_POST, [] {
    crumbWeb("/api/ota");
    if (!hostOk()) return sendError("Host is not this device", 403);
    if (!postHeaderOk()) return sendError("POST needs the header X-TempCtl: 1", 403);
    handleOtaDone();
    crumb(CR_LOOP, L_WEB);
  }, handleOtaUpload);
  server.onNotFound([] { sendBody(404, "text/plain", (const uint8_t*)"Not found", 9, "404"); });
  server.begin();
}

void webLoop() {
  server.handleClient();
  jobStep();
  if (restartAt && (int32_t)(millis() - restartAt) >= 0) {
    restartAt = 0;
    appRequestRestart("from the web page");
  }
}

// A request line of the serial api mode: {"id":7,"m":"GET","p":"/api/live?x=1","b":{...}}
// ("m": GET (default) / POST / PING). Answered through the same handlers as HTTP (see SerialReq).
void webApiRequest(const char* line) {
  uint32_t id = 0;
  char path[48], query[192];
  String body;
  bool post = false, ping = false;
  {
    JsonDocument q;
    if (deserializeJson(q, line) != DeserializationError::Ok) {
      static const char E[] = "{\"t\":\"error\",\"err\":\"bad JSON\"}\n";
      return apiOut(E, sizeof(E) - 1);
    }
    id = q["id"] | 0u;
    const char* m = q["m"] | "GET";
    post = !strcasecmp(m, "POST");
    ping = !strcasecmp(m, "PING");
    const char* p = q["p"] | "";
    const char* qm = strchr(p, '?');
    snprintf(path, sizeof(path), "%.*s", (int)(qm ? qm - p : (long)strlen(p)), p);
    strlcpy(query, qm ? qm + 1 : "", sizeof(query));
    if (!q["b"].isNull()) serializeJson(q["b"], body);
  }  // (the request document is freed before the handler runs)
  SerialReq r{id, path, query, String(), false};
  r.body = body;
  body = String();
  sreq = &r;
  if (ping) {
    JsonDocument d;
    d["ok"] = true;
    sendJson(d);
  } else {
    const Route* hit = nullptr;
    for (const Route& x : ROUTES)
      if (!strcmp(x.path, path) && x.method == (post ? HTTP_POST : HTTP_GET)) hit = &x;
    if (hit) {
      crumbWeb(hit->path);
      if (post) safetyActivity();
      hit->fn();
    } else {
      sendError("Not found", 404);
    }
    if (!r.answered) sendError("No answer", 500);
  }
  sreq = nullptr;
}
